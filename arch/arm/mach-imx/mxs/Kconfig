## arch/arm/mach-imx/mxs/Kconfig
```kconfig
if ARCH_MX28

config MX28
	bool
	default y

choice
	prompt "MX28 board select"
	optional

config TARGET_APX4DEVKIT
	bool "Support apx4devkit"

config TARGET_BG0900
	bool "Support bg0900"

config TARGET_SC_SPS_1
	bool "Support sc_sps_1"

config TARGET_TS4600
	bool "Support TS4600"

config TARGET_XEA
	bool "Support XEA"

endchoice

config SYS_SOC
	default "mxs"

source "board/bluegiga/apx4devkit/Kconfig"
source "board/liebherr/xea/Kconfig"
source "board/ppcag/bg0900/Kconfig"
source "board/schulercontrol/sc_sps_1/Kconfig"
source "board/technologic/ts4600/Kconfig"

endif
```

## arch/arm/mach-nuvoton/Kconfig
```kconfig
if ARCH_NPCM

config SYS_ARCH
	default "arm"

config SYS_TEXT_BASE
	default 0x8000

choice
	prompt "Nuvoton SoC select"
	default ARCH_NPCM8XX

config ARCH_NPCM8XX
	bool "Support Nuvoton NPCM8xx SoC"
	select ARM64
	help
	  General support for NPCM8xx BMC (Arbel).
	  Nuvoton NPCM8xx BMC is based on the Cortex A35.

endchoice

source "arch/arm/mach-nuvoton/npcm8xx/Kconfig"

endif
```

## arch/sandbox/Kconfig
```kconfig
menu "Sandbox architecture"
	depends on SANDBOX

config SYS_ARCH
	default "sandbox"

config SYS_BOARD
	default "sandbox"

config SYS_CPU
	default "sandbox"

config SANDBOX64
	bool "Use 64-bit addresses"
	select PHYS_64BIT
	select HOST_64BIT

config SANDBOX_RAM_SIZE_MB
	int "RAM size in MiB"
	default 128
	range 64 4095 if !SANDBOX64
	range 64 268435456 if SANDBOX64
	help
	  Memory size of the sandbox in MiB. The default value is 128 MiB.
	  The minimum value is 64 MiB. The maximum value is 4095 MiB for the
	  32bit sandbox.

config SANDBOX_SPL
	bool "Enable SPL for sandbox"
	select SUPPORT_SPL

config SYS_CONFIG_NAME
	default "sandbox_spl" if SANDBOX_SPL
	default "sandbox" if !SANDBOX_SPL

choice
	prompt "Run sandbox on 32/64-bit host"
	default HOST_DETECT_BITNESS
	help
	  Sandbox can be built on 32-bit and 64-bit hosts. This is generally
	  auto-detected but you can force a particular word size here. If you
	  see strange warnings about SANDBOX_BITS_PER_LONG then you may have
	  selected the wrong value.

config HOST_32BIT
	bool "32-bit host"
	depends on !PHYS_64BIT
	help
	  Select this if the host is a 32-bit machine. This adjusts various
	  tests and other features to work correctly in this environment. If
	  this option is enabled on 64-bit machines you may get build warnings
	  and/or errors.

config HOST_64BIT
	bool "64-bit host"
	help
	  Select this if the host is a 64-bit machine. This adjusts various
	  tests and other features to work correctly in this environment. If
	  this option is enabled on 32-bit machines you may get build warnings
	  and/or errors.

config HOST_DETECT_BITNESS
	bool "Auto-detect host bitness"
	help
	  Select this if you want the build system to determine the bitness
	  automatically. This compiles a small program during the build, then
	  runs it to determine the bitness using __WORDSIZE (32 or 64 bits).
	  Then it adds one of the above options (CONFIG_HOST_32 or
	  CONFIG_HOST_64) to the configuration when creating it.

	  In rare situations this may fail, e.g. on an unsupported Operating
	  System or toolchain, in which case you will likely get build warnings
	  and errors.

endchoice

config SANDBOX_CRASH_RESET
	bool "Reset on crash"
	help
	  If an illegal instruction or an illegal memory access occurs, the
	  sandbox by default writes a crash dump and exits. If you set this
	  flag, the sandbox is reset instead. This may be useful when running
	  test suites like the UEFI self certification test which continue
	  with the next test after a crash.

config SANDBOX_BITS_PER_LONG
	int
	default 32 if HOST_32BIT
	default 64 if HOST_64BIT

config SYS_FDT_LOAD_ADDR
	hex "Address at which to load devicetree"
	default 0x100
	help
	  With sandbox the devicetree is loaded into the emulated RAM. This sets
	  the address that is used. There must be enough space at this address
	  to load the full devicetree without it overwriting anything else.

	  See `doc/arch/sandbox.rst` for more information.

endmenu
```

## board/asus/transformer-t30/Kconfig
```kconfig
if TARGET_TRANSFORMER_T30

config SYS_BOARD
	default "transformer-t30"

config SYS_VENDOR
	default "asus"

config SYS_CONFIG_NAME
	default "transformer-t30"

config TRANSFORMER_SPI_BOOT
	bool "Enable support for SPI based flash"
	select TEGRA20_SLINK
	select DM_SPI_FLASH
	select SPI_FLASH_WINBOND
	default n
	help
	  Tegra 3 based Transformers with Windows RT have core
	  boot sequence (BCT and EBT) on separate SPI FLASH
	  memory with 4MB size.

config TRANSFORMER_HALL_GPIO
	int "Number of GPIO connected to HALL sensor"
	default 150
	help
	  If device has no HALL sensor, set this to 0.

config TRANSFORMER_ACTION_GPIO
	int "Number of GPIO connected to action key"
	default 131
	help
	  Transformers use volume down key as action key.

endif
```

## board/kontron/sl-mx8mm/Kconfig
```kconfig
if TARGET_KONTRON_MX8MM

config SYS_BOARD
	string
	default "sl-mx8mm"

config SYS_VENDOR
	string
	default "kontron"

config SYS_CONFIG_NAME
	string
	default "kontron_mx8mm"

endif
```

## board/samsung/starqltechn/Kconfig
```kconfig
if TARGET_STARQLTECHN

config SYS_BOARD
	default "starqltechn"
	help
	  starqltechn is a production board for S9 and S9+ phones(SM-G96x0) phones based on SDM845 SoC.

config SYS_VENDOR
	default "samsung"

config SYS_CONFIG_NAME
	default "starqltechn"

endif
```

## board/ti/j784s4/Kconfig
```kconfig
# SPDX-License-Identifier: GPL-2.0+
#
# Copyright (C) 2022 Texas Instruments Incorporated - https://www.ti.com/
#	Hari Nagalla <hnagalla@ti.com>

choice
	prompt "K3 J784S4 board"
	optional

config TARGET_J784S4_A72_EVM
	bool "TI K3 based J784S4 EVM running on A72"
	select ARM64
	select SOC_K3_J784S4
	select BOARD_LATE_INIT
	select SYS_DISABLE_DCACHE_OPS

config TARGET_J784S4_R5_EVM
	bool "TI K3 based J784S4 EVM running on R5"
	select CPU_V7R
	select SYS_THUMB_BUILD
	select SOC_K3_J784S4
	select K3_LOAD_SYSFW
	select RAM
	select SPL_RAM
	select K3_DDRSS
	imply SYS_K3_SPL_ATF

endchoice

if TARGET_J784S4_A72_EVM

config SYS_BOARD
       default "j784s4"

config SYS_VENDOR
       default "ti"

config SYS_CONFIG_NAME
       default "j784s4_evm"

source "board/ti/common/Kconfig"

endif

if TARGET_J784S4_R5_EVM

config SYS_BOARD
       default "j784s4"

config SYS_VENDOR
       default "ti"

config SYS_CONFIG_NAME
       default "j784s4_evm"

config SPL_LDSCRIPT
	default "arch/arm/mach-omap2/u-boot-spl.lds"

source "board/ti/common/Kconfig"

endif
```

## configs/M52277EVB_stmicro_defconfig
```kconfig
CONFIG_M68K=y
CONFIG_SYS_TEXT_BASE=0x43E00000
CONFIG_ENV_SIZE=0x1000
CONFIG_TARGET_M52277EVB=y
CONFIG_SYS_EXTRA_OPTIONS="CF_SBF,SYS_STMICRO_BOOT"
CONFIG_BOOTDELAY=3
# CONFIG_DISPLAY_BOARDINFO is not set
# CONFIG_CMDLINE_EDITING is not set
# CONFIG_AUTO_COMPLETE is not set
CONFIG_CMD_IMLS=y
CONFIG_CMD_I2C=y
# CONFIG_CMD_SETEXPR is not set
CONFIG_CMD_CACHE=y
CONFIG_CMD_DATE=y
CONFIG_CMD_JFFS2=y
CONFIG_DEFAULT_DEVICE_TREE="M52277EVB_stmicro"
CONFIG_SYS_RELOC_GD_ENV_ADDR=y
# CONFIG_NET is not set
CONFIG_MTD_NOR_FLASH=y
CONFIG_FLASH_CFI_DRIVER=y
CONFIG_SYS_FLASH_USE_BUFFER_WRITE=y
CONFIG_SYS_FLASH_PROTECTION=y
CONFIG_SYS_FLASH_CFI=y
```

## configs/M54418TWR_defconfig
```kconfig
CONFIG_M68K=y
CONFIG_SYS_TEXT_BASE=0x47E00000
CONFIG_ENV_SIZE=0x2000
CONFIG_TARGET_M54418TWR=y
CONFIG_SYS_EXTRA_OPTIONS="CF_SBF,SYS_SERIAL_BOOT,SYS_INPUT_CLKSRC=50000000"
CONFIG_USE_BOOTARGS=y
CONFIG_BOOTARGS="root=/dev/nfs rw nfsroot=192.168.1.1:/tftpboot/192.168.1.2  ip=192.168.1.2:192.168.1.1:192.168.1.1: 255.255.255.0::eth0:off:rw console=ttyS0,115200"
# CONFIG_DISPLAY_BOARDINFO is not set
CONFIG_HUSH_PARSER=y
# CONFIG_CMDLINE_EDITING is not set
# CONFIG_AUTO_COMPLETE is not set
CONFIG_SYS_PROMPT="-> "
# CONFIG_CMD_LOADB is not set
# CONFIG_CMD_LOADS is not set
# CONFIG_CMD_SETEXPR is not set
CONFIG_CMD_DHCP=y
CONFIG_CMD_MII=y
CONFIG_CMD_PING=y
CONFIG_CMD_CACHE=y
CONFIG_DEFAULT_DEVICE_TREE="M54418TWR"
CONFIG_SYS_RELOC_GD_ENV_ADDR=y
CONFIG_DM_ETH=y
CONFIG_MCFFEC=y
CONFIG_MII=y
```

## configs/am62x_lp_sk_a53_defconfig
```kconfig
#include <configs/am62x_evm_a53_defconfig>
CONFIG_DEFAULT_DEVICE_TREE="ti/k3-am62-lp-sk"
CONFIG_OF_UPSTREAM=y
```

## configs/am62x_lp_sk_r5_defconfig
```kconfig
#include <configs/am62x_evm_r5_defconfig>
CONFIG_DEFAULT_DEVICE_TREE="k3-am62-r5-lp-sk"
```

## configs/arbel_evb_defconfig
```kconfig
CONFIG_ARM=y
CONFIG_ARCH_NPCM=y
CONFIG_ARCH_NPCM8XX=y
CONFIG_TARGET_ARBEL_EVB=y
CONFIG_SYS_TEXT_BASE=0x8000
CONFIG_SYS_LOAD_ADDR=0x10000000
CONFIG_SYS_PROMPT="U-Boot>"
CONFIG_SYS_MALLOC_LEN=0x240000
CONFIG_SYS_MEMTEST_END=0x08000000
CONFIG_SYS_MEMTEST_START=0
CONFIG_DEFAULT_DEVICE_TREE="nuvoton-npcm845-evb"
CONFIG_ENV_IS_IN_SPI_FLASH=y
CONFIG_ENV_OFFSET=0x100000
CONFIG_ENV_SIZE=0x40000
CONFIG_ENV_SECT_SIZE=0x1000
CONFIG_ENV_ADDR=0x80100000
CONFIG_SF_DEFAULT_BUS=0
CONFIG_SF_DEFAULT_CS=0
CONFIG_NR_DRAM_BANKS=1
CONFIG_FIT=y
CONFIG_FIT_VERBOSE=y
CONFIG_HUSH_PARSER=y
CONFIG_MTD_DEVICE=y
CONFIG_MTD_PARTITIONS=y
CONFIG_OF_CONTROL=y
CONFIG_DM=y
CONFIG_DM_SERIAL=y
CONFIG_NPCM_SERIAL=y
CONFIG_TIMER=y
CONFIG_NPCM_TIMER=y
CONFIG_CLK=y
CONFIG_CMD_UUID=y
CONFIG_CMD_SAVEENV=y
CONFIG_PINCTRL=y
CONFIG_PINCTRL_NPCM8XX=y
CONFIG_PINCONF=y
CONFIG_DM_GPIO=y
CONFIG_NPCM_GPIO=y
CONFIG_CMD_GPIO=y
CONFIG_USB=y
CONFIG_USB_STORAGE=y
CONFIG_DM_USB=y
CONFIG_CMD_USB=y
CONFIG_USB_EHCI_HCD=y
CONFIG_USB_EHCI_GENERIC=y
CONFIG_USB_OHCI_NEW=y
CONFIG_USB_OHCI_HCD=y
CONFIG_USB_OHCI_GENERIC=y
CONFIG_CMD_FAT=y
CONFIG_SPI=y
CONFIG_DM_SPI=y
CONFIG_NPCM_FIU_SPI=y
CONFIG_DM_SPI_FLASH=y
CONFIG_SPI_FLASH=y
CONFIG_SPI_FLASH_MACRONIX=y
CONFIG_SPI_FLASH_WINBOND=y
CONFIG_CMD_SF=y
CONFIG_CMD_MEMORY=y
CONFIG_CMD_CACHE=y
CONFIG_CMD_SPI=y
CONFIG_CMD_PING=y
CONFIG_CMD_MII=y
CONFIG_CMD_DHCP=y
CONFIG_NET=y
CONFIG_NETDEVICES=y
CONFIG_PHY_BROADCOM=y
CONFIG_DM_ETH=y
CONFIG_PHY_GIGE=y
CONFIG_ETH_DESIGNWARE=y
CONFIG_RGMII=y
CONFIG_MII=y
# CONFIG_EFI is not set
# CONFIG_EFI_LOADER is not set
# CONFIG_ENV_IS_IN_FLASH is not set
# CONFIG_CMD_FLASH is not set
# CONFIG_PSCI_RESET is not set
# CONFIG_INPUT is not set
```

## configs/bcm28155_w1d_defconfig
```kconfig
CONFIG_ARM=y
CONFIG_ENABLE_ARM_SOC_BOOT0_HOOK=y
CONFIG_TARGET_BCM28155_AP=y
CONFIG_SYS_TEXT_BASE=0xae000000
CONFIG_ENV_SIZE=0x1000
CONFIG_NR_DRAM_BANKS=1
CONFIG_MISC_INIT_R=y
CONFIG_VERSION_VARIABLE=y
# CONFIG_DISPLAY_CPUINFO is not set
# CONFIG_DISPLAY_BOARDINFO is not set
CONFIG_HUSH_PARSER=y
# CONFIG_AUTOBOOT is not set
CONFIG_CMD_BOOTZ=y
CONFIG_CMD_ASKENV=y
CONFIG_CMD_MX_CYCLIC=y
CONFIG_CMD_GPIO=y
CONFIG_CMD_I2C=y
# CONFIG_CMD_SETEXPR is not set
# CONFIG_CMD_NFS is not set
CONFIG_CMD_CACHE=y
CONFIG_CMD_FAT=y
CONFIG_EFI_PARTITION=y
# CONFIG_PARTITION_UUIDS is not set
# CONFIG_ENV_IS_NOWHERE is not set
CONFIG_SYS_RELOC_GD_ENV_ADDR=y
CONFIG_HAVE_BLOCK_DEVICE=y
# CONFIG_MMC is not set
CONFIG_BCM_SF2_ETH=y
CONFIG_BCM_SF2_ETH_GMAC=y
CONFIG_SYS_NS16550=y
```

## configs/marsboard_defconfig
```kconfig
CONFIG_ARM=y
CONFIG_ARCH_MX6=y
CONFIG_SYS_TEXT_BASE=0x17800000
CONFIG_ENV_SIZE=0x2000
CONFIG_TARGET_EMBESTMX6BOARDS=y
CONFIG_NR_DRAM_BANKS=1
CONFIG_DISTRO_DEFAULTS=y
CONFIG_SYS_EXTRA_OPTIONS="IMX_CONFIG=board/boundary/nitrogen6x/nitrogen6q.cfg,MX6Q,DDR_MB=1024"
CONFIG_BOOTCOMMAND="run finduuid; run distro_bootcmd"
# CONFIG_CONSOLE_MUX is not set
CONFIG_SYS_CONSOLE_IS_IN_ENV=y
CONFIG_SYS_CONSOLE_OVERWRITE_ROUTINE=y
CONFIG_BOUNCE_BUFFER=y
CONFIG_BOARD_EARLY_INIT_F=y
CONFIG_CMD_GPIO=y
CONFIG_CMD_I2C=y
CONFIG_CMD_USB=y
CONFIG_CMD_CACHE=y
CONFIG_CMD_EXT4_WRITE=y
CONFIG_SYS_RELOC_GD_ENV_ADDR=y
CONFIG_DM=y
# CONFIG_MMC is not set
CONFIG_FSL_USDHC=y
CONFIG_PHYLIB=y
CONFIG_PHY_ATHEROS=y
CONFIG_MII=y
CONFIG_DM_THERMAL=y
CONFIG_USB=y
CONFIG_USB_HOST_ETHER=y
CONFIG_USB_ETHER_ASIX=y
CONFIG_DM_VIDEO=y
CONFIG_VIDEO_IPUV3=y
CONFIG_OF_LIBFDT=y
```

## configs/omap5_uevm_defconfig
```kconfig
CONFIG_ARM=y
CONFIG_ARCH_OMAP2PLUS=y
CONFIG_OMAP54XX=y
CONFIG_TARGET_OMAP5_UEVM=y
CONFIG_OMAP_PLATFORM_RESET_TIME_MAX_USEC=16296
CONFIG_SPL=y
CONFIG_ARMV7_LPAE=y
CONFIG_SPL_TEXT_BASE=0x40300000
CONFIG_DISTRO_DEFAULTS=y
# CONFIG_USE_BOOTCOMMAND is not set
CONFIG_SYS_CONSOLE_INFO_QUIET=y
CONFIG_VERSION_VARIABLE=y
# CONFIG_SPL_NAND_SUPPORT is not set
CONFIG_SPL_OS_BOOT=y
CONFIG_CMD_SPL=y
CONFIG_CMD_ASKENV=y
CONFIG_CMD_DFU=y
CONFIG_CMD_GPIO=y
CONFIG_CMD_GPT=y
CONFIG_CMD_I2C=y
CONFIG_CMD_SPI=y
# CONFIG_CMD_SETEXPR is not set
CONFIG_CMD_EXT4_WRITE=y
# CONFIG_ENV_IS_NOWHERE is not set
CONFIG_SYS_RELOC_GD_ENV_ADDR=y
CONFIG_ENV_VARS_UBOOT_RUNTIME_CONFIG=y
CONFIG_SCSI_AHCI=y
CONFIG_DFU_MMC=y
CONFIG_DFU_RAM=y
CONFIG_CMD_TCA642X=y
# CONFIG_MMC is not set
CONFIG_SCSI=y
CONFIG_CONS_INDEX=3
CONFIG_SYS_NS16550=y
CONFIG_SPI=y
CONFIG_OMAP3_SPI=y
CONFIG_FAT_WRITE=y
CONFIG_OF_LIBFDT=y
```

## configs/ot1200_defconfig
```kconfig
CONFIG_ARM=y
CONFIG_ARCH_MX6=y
CONFIG_SYS_TEXT_BASE=0x17800000
CONFIG_ENV_SIZE=0x10000
CONFIG_TARGET_OT1200=y
CONFIG_NR_DRAM_BANKS=1
CONFIG_SYS_EXTRA_OPTIONS="IMX_CONFIG=board/bachmann/ot1200/mx6q_4x_mt41j128.cfg,MX6Q"
CONFIG_BOOTDELAY=3
CONFIG_USE_PREBOOT=y
CONFIG_SUPPORT_RAW_INITRD=y
CONFIG_MISC_INIT_R=y
CONFIG_BOUNCE_BUFFER=y
CONFIG_BOARD_EARLY_INIT_F=y
CONFIG_HUSH_PARSER=y
CONFIG_CMD_BOOTZ=y
CONFIG_CMD_EEPROM=y
CONFIG_CMD_GPIO=y
CONFIG_CMD_I2C=y
CONFIG_CMD_DHCP=y
CONFIG_CMD_MII=y
CONFIG_CMD_PING=y
CONFIG_CMD_CACHE=y
CONFIG_CMD_EXT2=y
CONFIG_CMD_EXT4=y
CONFIG_CMD_EXT4_WRITE=y
CONFIG_CMD_FAT=y
CONFIG_CMD_FS_GENERIC=y
CONFIG_SYS_RELOC_GD_ENV_ADDR=y
CONFIG_DM=y
CONFIG_DWC_AHSATA=y
CONFIG_CMD_PCA953X=y
# CONFIG_MMC is not set
CONFIG_FSL_USDHC=y
CONFIG_PHYLIB=y
CONFIG_PHY_SMSC=y
CONFIG_MII=y
CONFIG_DM_THERMAL=y
CONFIG_USB_STORAGE=y
CONFIG_OF_LIBFDT=y
```

## configs/qemu_arm64_lwip_defconfig
```kconfig
#include <configs/qemu_arm64_defconfig>

CONFIG_ARM=y
CONFIG_ARCH_QEMU=y
CONFIG_NET_LWIP=y
# CONFIG_DFU_TFTP is not set
```

## configs/starqltechn_defconfig
```kconfig
CONFIG_TARGET_STARQLTECHN=y
CONFIG_ARM=y
CONFIG_ARM_SMCCC=y
CONFIG_ARCH_SNAPDRAGON=y
CONFIG_IDENT_STRING="\nSamsung S9 SM-G9600"
CONFIG_DEFAULT_DEVICE_TREE="starqltechn"
CONFIG_SYS_TEXT_BASE=0x80000000
CONFIG_POSITION_INDEPENDENT=y
CONFIG_BOARD_EARLY_INIT_F=n
CONFIG_SKIP_LOWLEVEL_INIT=y
CONFIG_DISPLAY_CPUINFO=n
CONFIG_HUSH_PARSER=y
CONFIG_OF_CONTROL=y
CONFIG_DM_STDIO=n
CONFIG_MSM_GPIO=y
CONFIG_DM_PMIC=y
CONFIG_PMIC_PM8916=y
CONFIG_PM8916_GPIO=y
CONFIG_SPMI_MSM=y
CONFIG_CLK=y
CONFIG_NET=n
CONFIG_USE_PREBOOT=y
CONFIG_CMD_GPIO=y
CONFIG_PINCTRL=y
CONFIG_MSM_GENI_SERIAL=y
# CONFIG_DEBUG_UART=y
# CONFIG_DEBUG_UART_MSM_GENI=y
# CONFIG_DEBUG_UART_BASE=0xa84000
# CONFIG_DEBUG_UART_CLOCK=7372800
# CONFIG_DEBUG_UART_ANNOUNCE=y
```

## drivers/crypto/Kconfig
```kconfig
menu "Hardware crypto devices"

source drivers/crypto/fsl/Kconfig

source drivers/crypto/aspeed/Kconfig

endmenu
```

## drivers/crypto/aspeed/Kconfig
```kconfig
config ASPEED_HACE
	bool "ASPEED Hash and Crypto Engine"
	depends on ASPEED_AST2600
	imply SHA_HW_ACCEL
	imply SHA_PROG_HW_ACCEL
	imply CMD_HASH
	help
	 Select this option to enable a driver for using the SHA engine in
	 the ASPEED BMC SoCs.

	 Enabling this allows the use of SHA operations in hardware without requiring the
	 SHA software implementations. It also improves performance and saves code size.

config ASPEED_ARCY
	bool "ASPEED RSA and ECC Engine"
	depends on ASPEED_AST2600
	help
	 Select this option to enable a driver for using the RSA/ECC engine in
	 the ASPEED BMC SoCs.

	 Enabling this allows the use of RSA/ECC operations in hardware without requiring the
	 software implementations. It also improves performance and saves code size.
```

## drivers/pinctrl/nuvoton/Kconfig
```kconfig
config PINCTRL_NPCM8XX
	bool "Pinctrl and GPIO driver for Nuvoton NPCM8XX"
	depends on DM && PINCTRL_GENERIC && ARCH_NPCM8XX
	help
	  Say Y here to enable pin controller and GPIO support
	  for Nuvoton NPCM8xx SoCs.
```
