## drivers/vibrator/Kconfig
```kconfig
menu "Vibrator Feedback Support"

config VIBRATOR
	bool "Enable vibration motor support"
	depends on DM
	help
	  Many boards have vibration motorss which can be used to signal status or
	  alerts. U-Boot provides a uclass API to implement this feature. Vibration
	  motor drivers can provide access to board-specific vibration motors. Use
	  of the device tree for configuration is encouraged.

config SPL_VIBRATOR
	bool "Enable vibration motor support in SPL"
	depends on SPL && SPL_DM
	help
	  The vibration motor subsystem adds a small amount of overhead to the image.
	  If this is acceptable and you have a need to use vibration motors in SPL,
	  enable this option. You will need to enable device tree in SPL
	  for this to work.

config VIBRATOR_GPIO
	bool "VIBRATOR support for GPIO-connected VIBRATORs"
	depends on VIBRATOR && DM_GPIO
	help
	  Enable support for vibration motors which are connected to GPIO lines.
	  These GPIOs may be on the SoC or some other device which provides GPIOs.
	  The GPIO driver must used driver model. vibration motors are configured
	  using the device tree.

config SPL_VIBRATOR_GPIO
	bool "Vibration motor support for GPIO-connected vibration motors in SPL"
        depends on SPL_VIBRATOR && DM_GPIO
	help
	  This option is an SPL-variant of the VIBRATOR_GPIO option.
	  See the help of VIBRATOR_GPIO for details.

endmenu
```

## net-lwip/Kconfig
```kconfig
#
# Network configuration (with lwIP stack)
#

menuconfig NET_LWIP
	bool "Networking support (lwIP stack) -- EXPERIMENTAL"
	imply NETDEVICES
	help
	  Include networking support based on the lwIP (lightweight IP)
	  TCP/IP stack (https://nongnu.org/lwip). This is a replacement for
	  the default U-Boot network stack and applications located in net/
	  and enabled via CONFIG_NET as well as other pieces of code that
	  depend on CONFIG_NET (such as cmd/net.c enabled via CONFIG_CMD_NET).
	  Therefore the two symbols CONFIG_NET and CONFIG_NET_LWIP are mutually
	  exclusive.

if NET_LWIP

config LWIP_DEBUG
	bool "Enable debug traces in the lwIP library"

config LWIP_ASSERT
	bool "Enable assertions in the lwIP library"

config PROT_DHCP_LWIP
	bool "DHCP support in lwIP"
	depends on PROT_UDP_LWIP
	help
	  Enable support for the DHCP protocol in lwIP.

config PROT_DNS_LWIP
	bool
	depends on PROT_UDP_LWIP

config PROT_RAW_LWIP
	bool

config PROT_TCP_LWIP
	bool

config PROT_UDP_LWIP
	bool

config BOOTDEV_ETH
        bool "Enable bootdev for ethernet"
        depends on BOOTSTD
        default y
        help
          Provide a bootdev for ethernet so that is it possible to boot
          an operating system over the network, using the PXE (Preboot
          Execution Environment) protocol.

endif
```

## tools/Kconfig
```kconfig
menu "Tools options"

config MKIMAGE_DTC_PATH
	string "Path to dtc binary for use within mkimage"
	default "dtc"
	help
	  The mkimage host tool will, in order to generate FIT images make
	  calls to the dtc application in order to create the output.  In
	  some cases the system dtc may not support all required features
	  and the path to a different version should be given here.

config HOST_CRC32
	def_bool y
	help
	  Enable CRC32 support in the host build

config HOST_FIT
	def_bool y
	help
	  Enable FIT support in the host build.

config HOST_FIT_FULL_CHECK
	def_bool y
	help
	  Do a full check of the FIT before using it in the host build

config HOST_FIT_PRINT
	def_bool y
	help
	  Print the content of the FIT verbosely in the host build

config HOST_FIT_RSASSA_PSS
	def_bool y
	help
	  Support the rsassa-pss signature scheme in the host build

config HOST_FIT_SHA1
	def_bool y
	help
	  Support SHA256 checksum of FIT image contents in the host build

config HOST_FIT_SHA256
	def_bool y
	help
	  Support SHA256 checksum of FIT image contents in the host build

config HOST_FIT_SHA384
	def_bool y
	help
	  Support SHA384 checksum of FIT image contents in the host build

config HOST_FIT_SHA512
	def_bool y
	help
	  Support SHA512 checksum of FIT image contents in the host build

config HOST_FIT_SIGNATURE
	def_bool y
	help
	  Enable signature verification of FIT uImages in the host build

config HOST_FIT_SIGNATURE_MAX_SIZE
	hex
	depends on HOST_FIT_SIGNATURE
	default 0x10000000

config HOST_FIT_VERBOSE
	def_bool y
	help
	  Support verbose FIT output in the host build

config HOST_MD5
	def_bool y
	help
	  Enable MD5 support in the host build

config HOST_OF_LIBFDT
	def_bool y
	help
	  Enable libfdt support in the host build.

config HOST_SHA1
	def_bool y
	help
	  Enable SHA1 support in the host build.

config HOST_SHA256
	def_bool y
	help
	  Enable SHA256 support in the host build.

config HOST_SHA384
	def_bool y
	help
	  Enable SHA384 support in the host build.

config HOST_SHA512
	def_bool y
	help
	  Enable SHA512 support in the host build.

endmenu
```
